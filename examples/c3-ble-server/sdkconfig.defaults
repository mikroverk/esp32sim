## examples/c3-ble-server/sdkconfig.defaults
```kconfig
CONFIG_IDF_TARGET="esp32c3"
CONFIG_APP_REPRODUCIBLE_BUILD=y
CONFIG_BT_ENABLED=y
CONFIG_BT_NIMBLE_ENABLED=y
CONFIG_BT_NIMBLE_ROLE_CENTRAL=n
CONFIG_BT_NIMBLE_ROLE_OBSERVER=n
CONFIG_BT_NIMBLE_ROLE_PERIPHERAL=y
CONFIG_BT_NIMBLE_ROLE_BROADCASTER=y
CONFIG_ESPTOOLPY_FLASHSIZE_4MB=y
CONFIG_COMPILER_OPTIMIZATION_SIZE=y
CONFIG_ESP_MAIN_TASK_STACK_SIZE=4096
```

## examples/classic-camera/sdkconfig.defaults
```kconfig
CONFIG_IDF_TARGET="esp32"
CONFIG_APP_REPRODUCIBLE_BUILD=y
CONFIG_APP_COMPILE_TIME_DATE=n
CONFIG_BOOTLOADER_COMPILE_TIME_DATE=n
CONFIG_SCCB_HARDWARE_I2C_PORT0=y
CONFIG_FREERTOS_UNICORE=y
CONFIG_SPIRAM=n
CONFIG_ESPTOOLPY_FLASHSIZE_4MB=y
CONFIG_ESP_CONSOLE_UART_BAUDRATE=115200
CONFIG_COMPILER_OPTIMIZATION_PERF=y
CONFIG_MBEDTLS_HARDWARE_SHA=n
CONFIG_ESP_MAIN_TASK_STACK_SIZE=8192
```
